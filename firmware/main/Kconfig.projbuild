## firmware/main/Kconfig.projbuild
```kconfig
menu "Conrad robot"
config ROBOT_SIMULATION
    bool "Simulated motors (TWAI never initialized)"
    default n
config ROBOT_BOARD_VERIFIED
    bool "Board, wiring, power, CAN and physical stop checked"
    default n
    help
        Only enable after completing docs/hardware.md. This does not verify motor settings.
config ROBOT_CAN_TX_GPIO
    int "TWAI TX GPIO (-1 = unconfirmed)"
    range -1 48
    default -1
config ROBOT_CAN_RX_GPIO
    int "TWAI RX GPIO (-1 = unconfirmed)"
    range -1 48
    default -1
config ROBOT_CAN_BITRATE
    int "Confirmed classic CAN bitrate (0 = unconfirmed)"
    default 0
config ROBOT_BOARD_NAME
    string "Exact board model and memory variant"
    default "UNCONFIRMED"
config ROBOT_AP_PASSWORD
    string "Hotspot WPA2 password (8-63 ASCII characters)"
    default ""
    help
        Empty generates a device password at boot and prints it on the local USB console.
        Set a private value with menuconfig for a stable field password. Never commit sdkconfig.
endmenu
```

## firmware/sdkconfig.defaults
```kconfig
CONFIG_IDF_TARGET="esp32s3"
CONFIG_ESPTOOLPY_FLASHSIZE_4MB=y
CONFIG_HTTPD_WS_SUPPORT=y
CONFIG_HTTPD_MAX_REQ_HDR_LEN=1024
CONFIG_FREERTOS_HZ=1000
CONFIG_COMPILER_CXX_EXCEPTIONS=n
CONFIG_ESP_WIFI_NVS_ENABLED=n
CONFIG_PARTITION_TABLE_SINGLE_APP_LARGE=y
CONFIG_ROBOT_SIMULATION=n
CONFIG_ROBOT_BOARD_VERIFIED=n
```
